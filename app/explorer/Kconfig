## app/explorer/Kconfig
```kconfig
# Copyright (c) 2021 Nordic Semiconductor ASA
# SPDX-License-Identifier: Apache-2.0
#
# This file is the application Kconfig entry point. All application Kconfig
# options can be defined here or included via other application Kconfig files.
# You can browse these options using the west targets menuconfig (terminal) or
# guiconfig (GUI).

rsource "src/modules/Kconfig.util_module"
rsource "src/modules/Kconfig.modules_common"
# rsource "src/modules/Kconfig.flash_module"
rsource "src/modules/Kconfig.can_module"

rsource "src/watchdog/Kconfig"
rsource "src/events/Kconfig"

menu "Zephyr"
source "Kconfig.zephyr"
endmenu


module = APP_MODULE
module-str = app module
source "subsys/logging/Kconfig.template.log_config"
```

## app/explorer/src/modules/Kconfig.can_module
```kconfig
#
# Copyright (c) 2021 Nordic Semiconductor
#
# SPDX-License-Identifier: LicenseRef-Nordic-5-Clause
#
menuconfig CAN_MODULE
	bool "Can module"
	default y

if CAN_MODULE

config CAN_THREAD_STACK_SIZE
	int "Can module thread stack size"
	default 1024 

endif # CAN_MODULE

module = CAN_MODULE
module-str = can module
source "subsys/logging/Kconfig.template.log_config"
```

## app/src/events/Kconfig
```kconfig
#
# Copyright (c) 2021 Nordic Semiconductor
#
# SPDX-License-Identifier: LicenseRef-Nordic-5-Clause
#

menuconfig EVENTS
	bool "Event options"
	default y

if EVENTS

config APP_EVENTS_LOG
	bool "Enable logging for application module events"
	default y

config SENSOR_EVENTS_LOG
	bool "Enable logging for sensor module events"
	default y

config CONTROL_EVENTS_LOG
	bool "Enable logging for control module events"
	default y

config HMI_EVENTS_LOG
	bool "Enable logging for hmi module events"
	default y	

config UTIL_EVENTS_LOG
	bool "Enable logging for utility module events"
	default y

config PID_EVENTS_LOG
	bool "Enable logging for pid module events"
	default y

config DEBUG_EVENTS_LOG
	bool "Enable logging for debug module events"
	default y

if NRF_PROFILER

choice
	prompt "Event type format for nrf_profiler"
	default NRF_PROFILER_EVENT_TYPE_INT

config NRF_PROFILER_EVENT_TYPE_STRING
	bool "Event type as string"

config NRF_PROFILER_EVENT_TYPE_INT
	bool "Event type as integer"

endchoice

endif # NRF_PROFILER

endif # EVENTS
```

## app/src/modules/Kconfig.flash_module
```kconfig
#
# Copyright (c) 2021 Nordic Semiconductor
#
# SPDX-License-Identifier: LicenseRef-Nordic-5-Clause
#
menuconfig FLASH_MODULE
	bool "Flash module"
	default y

if FLASH_MODULE

config FLASH_THREAD_STACK_SIZE
	int "Flash module thread stack size"
	default 4096 

endif # SENSOR_MODULE


module = FLASH_MODULE
module-str = flash module
source "subsys/logging/Kconfig.template.log_config"
```

## boards/st/stm32f4_atk_explorer/Kconfig.defconfig
```kconfig
# NUCLEO-144 F429ZI board configuration

# Copyright (c) 2017 Linaro Limited
# SPDX-License-Identifier: Apache-2.0

if BOARD_STM32F4_ATK_EXPLORER

if NETWORKING

config NET_L2_ETHERNET
	default y

endif # NETWORKING

endif # BOARD_STM32F4_ATK_EXPLORER
```

## boards/st/stm32f4_atk_explorer/board.yml
```yaml
board:
  name: stm32f4_atk_explorer
  vendor: st
  socs:
    - name: stm32f407xx
```

## subsys/Kconfig
```kconfig
#
# Copyright (c) 2018 - 2020 Nordic Semiconductor
#
# SPDX-License-Identifier: LicenseRef-Nordic-5-Clause
#

menu "Subsystems"
rsource "app_event_manager/Kconfig"
rsource "app_event_manager_profiler_tracer/Kconfig"
rsource "caf/Kconfig"
endmenu
```
