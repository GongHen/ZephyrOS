## CMakeLists.txt
```
#-------------------------------------------------------------------------------
# Zephyr Example Application
#
# Copyright (c) 2021 Nordic Semiconductor ASA
# SPDX-License-Identifier: Apache-2.0

cmake_minimum_required(VERSION 3.20.0)

list(APPEND BOARD_ROOT ${CMAKE_CURRENT_SOURCE_DIR}/) # new add, set BOARD_ROOT.

find_package(Zephyr REQUIRED HINTS $ENV{ZEPHYR_BASE})

project(app LANGUAGES C)

target_sources(app PRIVATE src/main.c)


target_sources(app PRIVATE
		src/modules/util_module.c
		src/modules/modules_common.c
        src/modules/flash_module.c
)

target_sources(app PRIVATE
		src/events/util_module_event.c
)

# target_sources(app PRIVATE
# )

zephyr_library_include_directories(src/modules)
zephyr_library_include_directories(src/Algorithm)
zephyr_library_include_directories(src/events)

zephyr_library_include_directories(${ZEPHYR_BASE}/drivers/flash)

add_subdirectory_ifdef(CONFIG_WATCHDOG_APPLICATION src/watchdog)

# exec_program(
#     "git"
#     ${CMAKE_CURRENT_SOURCE_DIR}
#     ARGS "log -1 --format=%H "
#     OUTPUT_VARIABLE VERSION_HASH )

# add_definitions( -DGIT_HASH="${VERSION_HASH}" )

find_package(Git)
# 生成版本描述字符串类似 TAG-X-gHASH
execute_process(COMMAND ${GIT_EXECUTABLE} describe --abbrev=6 --dirty --always --tags
    WORKING_DIRECTORY ${CMAKE_SOURCE_DIR}
    OUTPUT_VARIABLE  GIT_REPO_VERSION 
    OUTPUT_STRIP_TRAILING_WHITESPACE
)
# 获取最新 commit 日期，YYYY-MM-DD
execute_process(COMMAND ${GIT_EXECUTABLE} log -1 --format=%cd --date=short
    WORKING_DIRECTORY ${CMAKE_SOURCE_DIR}
    OUTPUT_VARIABLE  GIT_REPO_DATE
    OUTPUT_STRIP_TRAILING_WHITESPACE
)
# 获取最新 commit Hash
execute_process(COMMAND ${GIT_EXECUTABLE} log -1 --format=%H
    WORKING_DIRECTORY ${CMAKE_SOURCE_DIR}
    OUTPUT_VARIABLE  GIT_REPO_HASH
    OUTPUT_STRIP_TRAILING_WHITESPACE
)
# 写入头文件宏定义的版本字符串，日期和 Hash
file(WRITE ${PROJECT_BINARY_DIR}/repo_version.h
    "#define REPO_VERSION \"${GIT_REPO_VERSION}\"\n#define REPO_DATE \"${GIT_REPO_DATE}\"\n#define REPO_HASH \"${GIT_REPO_HASH}\"\n"
)
# 包含引用目录，源文件可以直接用 #include "repo_version.h" 包含
include_directories(${PROJECT_BINARY_DIR})

aux_source_directory(. SRC)
# 添加头文件依赖，保证更改后重新编译
# add_executable(app ${SRC} ${PROJECT_BINARY_DIR}/repo_version.h)
```

## Kconfig
```
# Copyright (c) 2021 Nordic Semiconductor ASA
# SPDX-License-Identifier: Apache-2.0
#
# This file is the application Kconfig entry point. All application Kconfig
# options can be defined here or included via other application Kconfig files.
# You can browse these options using the west targets menuconfig (terminal) or
# guiconfig (GUI).

rsource "src/modules/Kconfig.util_module"
rsource "src/modules/Kconfig.modules_common"
rsource "src/modules/Kconfig.flash_module"

rsource "src/watchdog/Kconfig"
rsource "src/events/Kconfig"

menu "Zephyr"
source "Kconfig.zephyr"
endmenu


module = APP_MODULE
module-str = app module
source "subsys/logging/Kconfig.template.log_config"
```

## prj.conf
```kconfig
# Copyright (c) 2021 Nordic Semiconductor ASA
# SPDX-License-Identifier: Apache-2.0
#
# This file contains selected Kconfig options for the application.

CONFIG_SENSOR=y
CONFIG_BLINK=y

CONFIG_CBPRINTF_FP_SUPPORT=y

CONFIG_PRINTK=y
CONFIG_HEAP_MEM_POOL_SIZE=256
CONFIG_ASSERT=y

CONFIG_SERIAL=y
# CONFIG_RING_BUFFER=y
# CONFIG_UART_INTERRUPT_DRIVEN=y
CONFIG_UART_ASYNC_API=y

# CONFIG_POLL=y
# CONFIG_CAN=y
# CONFIG_CAN_INIT_PRIORITY=80
# CONFIG_CAN_MAX_FILTER=5

CONFIG_SHELL=y
# CONFIG_CAN_SHELL=y
# CONFIG_DEVICE_SHELL=y

# CONFIG_STATS=y
# CONFIG_STATS_NAMES=y
# CONFIG_STATS_SHELL=y
# CONFIG_CAN_STATS=y

CONFIG_I2C=y
# CONFIG_I2C_TARGET=y
# CONFIG_I2C_EEPROM_TARGET=y
CONFIG_EEPROM=y

CONFIG_PWM=y

CONFIG_ADC=y


# Enable binary descriptors
CONFIG_BINDESC=y

# Enable definition of binary descriptors
CONFIG_BINDESC_DEFINE=y

# Enable default build time binary descriptors
CONFIG_BINDESC_DEFINE_BUILD_TIME=y
CONFIG_BINDESC_BUILD_DATE_TIME_STRING=y

# Enable default version binary descriptors
CONFIG_BINDESC_DEFINE_VERSION=y
CONFIG_BINDESC_KERNEL_VERSION_STRING=y
CONFIG_BINDESC_KERNEL_VERSION_MAJOR=y

CONFIG_BINDESC_APP_VERSION_STRING=y

# Enable default host info binary descriptors
CONFIG_BINDESC_DEFINE_HOST_INFO=y
CONFIG_BINDESC_C_COMPILER_NAME=y
CONFIG_BINDESC_C_COMPILER_VERSION=y

# CPU
CONFIG_SCHED_THREAD_USAGE_ANALYSIS=y
CONFIG_SCHED_THREAD_USAGE_ALL=y

CONFIG_SHELL=y
CONFIG_KERNEL_SHELL=y
CONFIG_THREAD_RUNTIME_STATS=y


# Watchdog
CONFIG_WATCHDOG=y
CONFIG_WATCHDOG_APPLICATION=y

# cmdis-dsp
CONFIG_CMSIS_DSP=y
# CONFIG_CMSIS_DSP_FILTERING=y

# Configuration required by Application Event Manager
CONFIG_APP_EVENT_MANAGER=y
CONFIG_HEAP_MEM_POOL_SIZE=2048
CONFIG_REBOOT=y

# CAF
CONFIG_CAF=y
# CONFIG_NRF_PROFILER=n

#Filesystem
CONFIG_FILE_SYSTEM=y
CONFIG_FILE_SYSTEM_LITTLEFS=y
CONFIG_FS_LITTLEFS_CACHE_SIZE=4096
CONFIG_FS_LITTLEFS_PROG_SIZE=256
CONFIG_FS_LITTLEFS_READ_SIZE=256
CONFIG_FS_LITTLEFS_LOOKAHEAD_SIZE=256
CONFIG_FS_LITTLEFS_FC_HEAP_SIZE=8192
CONFIG_NOCACHE_MEMORY=y

# FLASH
CONFIG_FLASH=y
CONFIG_STDOUT_CONSOLE=y
CONFIG_FLASH_JESD216_API=y

# Assume the standard SPI NOR flash driver.  If the device uses
# another driver add an override configuration in boards/.
CONFIG_SPI=y
CONFIG_SPI_NOR=y
CONFIG_SPI_NOR_FLASH_LAYOUT_PAGE_SIZE=4096
CONFIG_GPIO=y

CONFIG_FLASH_LOG_LEVEL_DBG=y


# LOG
CONFIG_LOG=y
CONFIG_CONSOLE=y
CONFIG_LOG_MODE_DEFERRED=y

# MODULE LOG LEVEL
CONFIG_APP_MODULE_LOG_LEVEL_DBG=y
CONFIG_UTIL_MODULE_LOG_LEVEL_DBG=y
CONFIG_WATCHDOG_LOG_LEVEL_INF=y
CONFIG_FLASH_MODULE_LOG_LEVEL_DBG=y
```

## src/main.c
```c
/*
 * Copyright (c) 2021 Nordic Semiconductor ASA
 * SPDX-License-Identifier: Apache-2.0
 */

#include <zephyr/kernel.h>
#include <zephyr/sys/reboot.h>
#include <zephyr/drivers/sensor.h>
#include <zephyr/logging/log.h>
#include <zephyr/sys/printk.h>

#include <zephyr/bindesc.h>


#include <app_event_manager.h>


#include <app_version.h>

#include "repo_version.h"


/* Module name is used by the Application Event Manager macros in this file */
#define MODULE main
#include <caf/events/module_state_event.h>

#include "modules_common.h"

LOG_MODULE_REGISTER(MODULE, CONFIG_APP_MODULE_LOG_LEVEL);


int main(void)
{
	printk("Zephyr version: %s\n", BINDESC_GET_STR(kernel_version_string));
	printk("App version: %s\n", BINDESC_GET_STR(app_version_string));
	printk("Build time: %s\n", BINDESC_GET_STR(build_date_time_string));
	printk("Compiler: %s %s\n", BINDESC_GET_STR(c_compiler_name),
		BINDESC_GET_STR(c_compiler_version));

    // printk("App Version %d.%d-%s-%s\n", APP_VERSION_MAJOR, APP_VERSION_MINOR, REPO_DATE, REPO_HASH);
	// printk("version: %s\n", REPO_VERSION);
    // printk("date: %s\n", REPO_DATE);
    // printk("hash: %s\n", REPO_HASH);
	printk("App Version %s-%s-%s\n", BINDESC_GET_STR(app_version_string), REPO_DATE, REPO_HASH);
	
	// printk("App build version: %s\n", APP_BUILD_VERSION);

	if (app_event_manager_init()) {
		/* Without the Application Event Manager, the application will not work
		 * as intended. A reboot is required in an attempt to recover.
		 */
		LOG_ERR("Application Event Manager could not be initialized, rebooting...");
		k_sleep(K_SECONDS(5));
		sys_reboot(SYS_REBOOT_COLD);		
	} else {
		module_set_state(MODULE_STATE_READY);
	}	

	return 0;
}
```
